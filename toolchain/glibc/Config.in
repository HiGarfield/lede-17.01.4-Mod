## toolchain/glibc/Config.in
```kconfig
choice
	prompt "glibc version"
	depends on TOOLCHAINOPTS && USE_GLIBC && !EXTERNAL_TOOLCHAIN
	default GLIBC_USE_VERSION_2_26
	help
	  Select the version of glibc you wish to use.

	config GLIBC_USE_VERSION_2_26
		bool "glibc 2.26"
		select GLIBC_VERSION_2_26

endchoice
```
